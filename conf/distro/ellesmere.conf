## conf/distro/ellesmere.conf
```bitbake
#
# Copyright (C) 2023 Wind River Systems, Inc.
#

#@TYPE: Distro
#@NAME: Wind River Distro
#@DESCRIPTION: Wind River Distro (Full Featured Distribution)

WRLINUX_VARIANT = " Distro"

DISTRO_CODENAME = "ellesmere"

DISTRO_FEATURES:append = " x11 opengl wayland vulkan polkit usrmerge security noalternatives"

# Kernel stuff
# Containers should overwrite this with 'linux-dummy'
PREFERRED_PROVIDER_virtual/kernel ?= "linux-yocto"
# Can't install to /boot per ostree
KERNEL_IMAGEDEST = "usr/lib/modules/6.1.38-yocto-standard"
# Easier to deal with a single modules package
KERNEL_SPLIT_MODULES = "0"

# Ensure our weak assignments "??=" and "?=" are taken by
# keeping this require at or near the bottom of this file
require conf/distro/wrlinux.conf

# Recipes not supported in WRLx but needed for Distro
CUSTOMER_RECIPES:openembedded-layer += 'zchunk'
CUSTOMER_RECIPES:openembedded-layer += 'tmux'
CUSTOMER_RECIPES:openembedded-layer += 'dumb-init'
CUSTOMER_RECIPES:virtualization-layer += 'python3-boto3'
CUSTOMER_RECIPES:virtualization-layer += 'python3-botocore'
CUSTOMER_RECIPES:meta-python += 'python3-astroid'
CUSTOMER_RECIPES:meta-python += 'python3-isort'
CUSTOMER_RECIPES:meta-python += 'python3-lazy-object-proxy'
CUSTOMER_RECIPES:meta-python += 'python3-pylint'
CUSTOMER_RECIPES:filesystems-layer += 'xorriso'
CUSTOMER_RECIPES:openembedded-layer += 'transmission'
CUSTOMER_RECIPES:filesystems-layer += 'xorriso'
CUSTOMER_RECIPES:openembedded-layer += 'fwupd'
CUSTOMER_RECIPES:openembedded-layer += 'modemmanager'
CUSTOMER_RECIPES:openembedded-layer += 'libgusb'
CUSTOMER_RECIPES:openembedded-layer += 'libjcat'
CUSTOMER_RECIPES:openembedded-layer += 'libqmi'
CUSTOMER_RECIPES:openembedded-layer += 'fwupd-efi'
CUSTOMER_RECIPES:openembedded-layer += 'flashrom'
CUSTOMER_RECIPES:openembedded-layer += 'libxmlb'
CUSTOMER_RECIPES:openembedded-layer += 'gcab'
CUSTOMER_RECIPES:openembedded-layer += 'cpuid'
CUSTOMER_RECIPES:openembedded-layer += 'libmbim'
CUSTOMER_RECIPES:openembedded-layer += 'libftdi'
CUSTOMER_RECIPES:networking-layer += 'ipcalc'
CUSTOMER_RECIPES:openembedded-layer += 'dbus-broker'
CUSTOMER_RECIPES:networking-layer += 'cifs-utils'
CUSTOMER_RECIPES:networking-layer += 'iscsi-initiator-utils'
CUSTOMER_RECIPES:networking-layer += 'open-isns'
CUSTOMER_RECIPES:virtualization-layer += 'crun'
CUSTOMER_RECIPES:openembedded-layer += 'nvme-cli'

WRLINUX_SUPPORTED_RECIPE:pn-libmbim = '2'
WRLINUX_SUPPORTED_RECIPE:pn-libqmi = '2'
WRLINUX_SUPPORTED_RECIPE:pn-libftdi = '2'
WRLINUX_SUPPORTED_RECIPE:pn-cpuid = '2'
WRLINUX_SUPPORTED_RECIPE:pn-flashrom = '2'
WRLINUX_SUPPORTED_RECIPE:pn-fwupd-efi = '2'
WRLINUX_SUPPORTED_RECIPE:pn-libjcat = '2'
WRLINUX_SUPPORTED_RECIPE:pn-libgusb = '2'
WRLINUX_SUPPORTED_RECIPE:pn-gcab = '2'
WRLINUX_SUPPORTED_RECIPE:pn-libxmlb = '2'
WRLINUX_SUPPORTED_RECIPE:pn-fwupd = '2'
WRLINUX_SUPPORTED_RECIPE:pn-modemmanager = '2'
WRLINUX_SUPPORTED_RECIPE:pn-ipcalc = '2'
```
